## arch/arm/configs/jactive_eur_defconfig
```kconfig
CONFIG_MACH_JACTIVE_EUR=y
CONFIG_EXTRA_FIRMWARE="audience-es325-fw-jactive-eur.bin"
CONFIG_EXTRA_FIRMWARE_DIR="firmware"
CONFIG_FB_MSM_MIPI_RENESAS_TFT_VIDEO_FULL_HD_PT_PANEL=y
CONFIG_DISPLAY_DISABLE_TEST_KEY=y
CONFIG_SUPPORT_DISPLAY_OCTA_TFT=y
CONFIG_FB_MSM_ENABLE_LCD_EN2=y
CONFIG_ESD_ERR_FG_RECOVERY=y
CONFIG_TOUCHSCREEN_SYNAPTICS_PREVENT_HSYNC_LEAKAGE=y
CONFIG_S5K3H5XA=y
CONFIG_S5K6B2YX=y
CONFIG_CAMERA_SW_I2C_ACT=y
CONFIG_IMX175_EEPROM=y
```

## arch/arm/configs/jf_att_defconfig
```kconfig
CONFIG_MACH_JF_ATT=y
CONFIG_EXTRA_FIRMWARE="audience-es325-fw.bin"
CONFIG_EXTRA_FIRMWARE_DIR="firmware"
CONFIG_IRDA_MC96=y
CONFIG_FB_MSM_MIPI_SAMSUNG_OCTA_VIDEO_FULL_HD_PT_PANEL=y
CONFIG_LCD_VDD3_BY_PMGPIO=y
```

## arch/arm/configs/jf_cmcccsfb_defconfig
```kconfig
CONFIG_MACH_JF_EUR=y
CONFIG_EXTRA_FIRMWARE="audience-es325-fw-cmcc.bin"
CONFIG_EXTRA_FIRMWARE_DIR="firmware"
CONFIG_RTC_AUTO_PWRON=y
CONFIG_RTC_AUTO_PWRON_PARAM=y
CONFIG_TARGET_LOCALE_CHN=y
CONFIG_WLAN_REGION_CODE=300
CONFIG_MACH_JF_CMCC=y
CONFIG_MACH_JF_CMCCCSFB=y
CONFIG_FB_MSM_MIPI_SAMSUNG_OCTA_VIDEO_FULL_HD_PT_PANEL=y
CONFIG_LCD_VDD3_BY_PMGPIO=y
```

## arch/arm/configs/jf_lgt_defconfig
```kconfig
CONFIG_TARGET_LOCALE_KOR=y
CONFIG_MACH_JF_LGT=y
CONFIG_EXTRA_FIRMWARE="audience-es325-fw-kor.bin"
CONFIG_EXTRA_FIRMWARE_DIR="firmware"
CONFIG_TDMB=y
CONFIG_TDMB_VENDOR_TELECHIPS=y
CONFIG_TDMB_TCC3170=y
CONFIG_TDMB_SPI=y
CONFIG_TDMB_ANT_DET=y
CONFIG_WLAN_REGION_CODE=203
CONFIG_LGUIWLAN=y
CONFIG_CAMERA_SW_I2C=y
CONFIG_CAMERA_USE_GSBI7=y
CONFIG_FB_MSM_MIPI_SAMSUNG_OCTA_VIDEO_FULL_HD_PT_PANEL=y
CONFIG_LCD_VDD3_BY_PMGPIO=y
```

## arch/arm/configs/jf_tmo_defconfig
```kconfig
CONFIG_MACH_JF_TMO=y
CONFIG_EXTRA_FIRMWARE="audience-es325-fw-tmo.bin"
CONFIG_EXTRA_FIRMWARE_DIR="firmware"
CONFIG_WLAN_REGION_CODE=402
CONFIG_FB_MSM_MIPI_SAMSUNG_OCTA_VIDEO_FULL_HD_PT_PANEL=y
CONFIG_LCD_VDD3_BY_PMGPIO=y
```

## arch/arm/configs/jf_vzw_defconfig
```kconfig
CONFIG_MACH_JF_EUR=y
CONFIG_EXTRA_FIRMWARE="audience-es325-fw-vzw.bin"
CONFIG_EXTRA_FIRMWARE_DIR="firmware"
CONFIG_FB_MSM_MIPI_SAMSUNG_OCTA_VIDEO_FULL_HD_PT_PANEL=y
CONFIG_LCD_VDD3_BY_PMGPIO=y
```

## arch/arm/configs/jfve3g_eur_defconfig
```kconfig
CONFIG_MACH_JFVE_EUR=y
CONFIG_MACH_JFVE_EUR_3G=y
CONFIG_EXTRA_FIRMWARE="audience-es325-fw-eur.bin"
CONFIG_EXTRA_FIRMWARE_DIR="firmware"
CONFIG_FB_MSM_MIPI_SAMSUNG_OCTA_VIDEO_FULL_HD_PT_PANEL=y
CONFIG_LCD_VDD3_BY_PMGPIO=y
CONFIG_MSM_PIL_RIVA=y
CONFIG_MSM_WCNSS_SSR_8960=y
CONFIG_PRIMA_WLAN_11AC_HIGH_TP=y
CONFIG_PRIMA_WLAN_LFR=y
CONFIG_PRIMA_WLAN=m
CONFIG_PRIMA_WLAN_OKC=y
CONFIG_QCOM_VOWIFI_11R=y
CONFIG_WCNSS_CORE=y
CONFIG_WCNSS_MEM_PRE_ALLOC=y
CONFIG_WIRELESS_EXT=y
# CONFIG_BCM4335 is not set
# CONFIG_BT_BCM4335 is not set
# CONFIG_BT_HCIUART_H4 is not set
# CONFIG_BT_HCIUART is not set
# CONFIG_CFG80211_WEXT is not set
# CONFIG_MMC_MSM_SDC2_SUPPORT is not set
# CONFIG_MMC_MSM_SDC4_SUPPORT is not set
# CONFIG_WIRELESS_EXT_SYSFS is not set
```
